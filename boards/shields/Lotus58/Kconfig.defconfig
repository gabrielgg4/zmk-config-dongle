## boards/shields/Lotus58/Kconfig.defconfig
```kconfig
# Copyright (c) 2022 The ZMK Contributors
# SPDX-License-Identifier: MIT
if SHIELD_LOTUS58_DONGLE || SHIELD_LOTUS58_LEFT 

config ZMK_KEYBOARD_NAME
	default "Lotus58"
	
config ZMK_SPLIT_BLE_ROLE_CENTRAL
	default y
	
config ZMK_USB
	default y

endif

if SHIELD_LOTUS58_LEFT_PERIPHERAL || SHIELD_LOTUS58_RIGHT || SHIELD_LOTUS58_DONGLE || SHIELD_LOTUS58_LEFT

config ZMK_SPLIT
	default y

config ZMK_BLE
	default y
	
if ZMK_DISPLAY

config I2C
    default y

config SSD1306
    default y

if SHIELD_LOTUS_DONGLE_PRO_MICRO

choice ZMK_DISPLAY_WORK_QUEUE
    default ZMK_DISPLAY_WORK_QUEUE_DEDICATED
endchoice

endif # choice

endif # ZMK_DISPLAY

if LVGL

config LV_Z_VDB_SIZE
    default 64

config LV_DPI_DEF
    default 148

config LV_Z_BITS_PER_PIXEL
    default 1

choice LV_COLOR_DEPTH
    default LV_COLOR_DEPTH_1
endchoice

endif # LVGL

endif
```
